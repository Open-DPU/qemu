## hw/remote/Kconfig
```kconfig
config MULTIPROCESS
    bool
    depends on PCI && PCI_EXPRESS && KVM
    select REMOTE_PCIHOST

config VFIO_USER_SERVER
    bool
    depends on MULTIPROCESS

config REMOTE_PCIE_PORT
    bool
    default y
    depends on PCI && PCI_EXPRESS
```
